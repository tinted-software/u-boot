## board/google/lynx/Kconfig
```kconfig
if TARGET_GOOGLE_LYNX

config SYS_BOARD
	default "lynx"

config SYS_VENDOR
	default "google"

config SYS_CONFIG_NAME
	default "google_lynx"

config SYS_SOC
	default "gs201"

config TEXT_BASE
	default 0x80080000

config LNX_KRNL_IMG_TEXT_OFFSET_BASE
	default TEXT_BASE

config DEFAULT_DEVICE_TREE
	default "google/gs201-lynx"

endif
```

## configs/google_lynx_defconfig
```kconfig
CONFIG_ARM=y
CONFIG_SKIP_LOWLEVEL_INIT=y
CONFIG_COUNTER_FREQUENCY=24576000
CONFIG_POSITION_INDEPENDENT=y
CONFIG_ARCH_EXYNOS=y
CONFIG_TARGET_GOOGLE_LYNX=y
CONFIG_SYS_MALLOC_LEN=0x2000000
CONFIG_SYS_MALLOC_F_LEN=0x16000
CONFIG_SYS_INIT_SP_BSS_OFFSET=0x400000
CONFIG_NR_DRAM_BANKS=8
CONFIG_DEFAULT_DEVICE_TREE="google/gs201-lynx"
CONFIG_OF_UPSTREAM=y
CONFIG_OF_BOARD=y
CONFIG_SYS_BOOTM_LEN=0x4000000
CONFIG_SYS_LOAD_ADDR=0x80200000
CONFIG_ARMV8_CNTFRQ_BROKEN=y
CONFIG_BUTTON_CMD=y
CONFIG_USE_PREBOOT=y
CONFIG_SAVE_PREV_BL_FDT_ADDR=y
CONFIG_SAVE_PREV_BL_INITRAMFS_START_ADDR=y
CONFIG_SYS_PBSIZE=1024
CONFIG_BOARD_TYPES=y
CONFIG_MISC_INIT_R=y
CONFIG_HUSH_PARSER=y
CONFIG_CMD_BOOTMENU=y
CONFIG_CMD_POWEROFF=y
CONFIG_CMD_FS_GENERIC=y
CONFIG_EFI_PARTITION=y
CONFIG_BLKMAP=y
CONFIG_USB_FUNCTION_FASTBOOT=y
CONFIG_FASTBOOT_BUF_ADDR=0x90000000
CONFIG_FASTBOOT_BUF_SIZE=0x10000000
CONFIG_FASTBOOT_FLASH=y
CONFIG_FASTBOOT_FLASH_MMC_DEV=0
CONFIG_MISC=y
CONFIG_SERIAL_S5P=y
CONFIG_S5P_SERIAL=y
CONFIG_DM_SERIAL=y
CONFIG_BAUDRATE=115200
CONFIG_SYSRESET=y
CONFIG_SYSRESET_CMD_POWEROFF=y
CONFIG_SYSRESET_PSCI=y
CONFIG_USB=y
CONFIG_DM_USB_GADGET=y
CONFIG_USB_GADGET=y
CONFIG_USB_GADGET_DOWNLOAD=y
CONFIG_USB_GADGET_VBUS_DRAW=2
CONFIG_USB_GADGET_DUALSPEED=y
CONFIG_CMD_BOOTZ=y
CONFIG_CMD_BOOTI=y
CONFIG_CMD_EXT2=y
CONFIG_CMD_EXT4=y
CONFIG_CMD_FAT=y
CONFIG_CMD_PART=y
CONFIG_CMD_MMC=y
CONFIG_CMD_USB=y
CONFIG_CMD_FASTBOOT=y
CONFIG_DOS_PARTITION=y
CONFIG_FS_EXT4=y
CONFIG_FS_FAT=y
CONFIG_BOOTSTD_FULL=y
CONFIG_ANDROID_BOOT_IMAGE=y
CONFIG_ENV_USE_DEFAULT_ENV_TEXT_FILE=y
CONFIG_ENV_DEFAULT_ENV_TEXT_FILE="board/google/lynx/lynx.env"
```

## drivers/video/exynos/Kconfig
```kconfig
menuconfig VIDEO_EXYNOS
	bool "Enable Exynos video support"
	depends on VIDEO && ARCH_EXYNOS
	help
	  Enable support for various video output options on Exynos SoCs.

if VIDEO_EXYNOS

config EXYNOS_DP
	bool "Exynos Display Port support"

config EXYNOS_FB
	bool "Exynos FIMD support"
	imply VIDEO_DAMAGE

config EXYNOS_MIPI_DSIM
	bool "Exynos MIPI DSI support"
	depends on EXYNOS_FB

config EXYNOS_GS201_DECON
	bool "Google Tensor GS201 DECON/DPU display"
	help
	  Adopt the RDMA/DPU plane left running by the ABL bootloader on
	  Google Tensor GS201 (Pixel 7a / lynx), force a linear scanout
	  buffer and expose it as a U-Boot video console. The MIPI-DSIM
	  and panel are left untouched and keep running from ABL.

endif
```
